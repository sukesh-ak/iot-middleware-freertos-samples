## demo/projects/esp32/az-esp-freertos/Kconfig.projbuild
```kconfig
menu "Azure ESP32 FreeRTOS App Config"

config WIFI_SSID
    string "WiFi SSID"
	default "myssid"
	help
		SSID (network name) for the example to connect to.

config WIFI_PASSWORD
    string "WiFi Password"
	default "mypassword"
	help
		WiFi password (WPA or WPA2) for the example to use.

		Can be left blank if the network has no security set.

config WIFI_MAXIMUM_RETRY
	int "Maximum Wifi Connection Retry"
	default 5
	help
		Set the Maximum Retry to connect to desire WIFI Access Point

config MQTT_CLIENT_IDENTIFIER
    string "The MQTT client identifier used for this device"
	default "esp32testclient"
	help
        The MQTT client identifier used in this example. Each client identifier must be unique.
        so edit as required to ensure that no two clients connecting to the same broker use the same client identifier.

config MQTT_BROKER_ENDPOINT
    string "HostName aka Endpoint of the Azure IoT Hub/MQTT broker to connect to"
    default "iothub.azure.com"
    help
        This should be the IoT Hub HostName from targeted IoT Hub.

config MQTT_BROKER_PORT
    int "Port of the AZure IoT Hub MQTT broker to be used"
    default 8883
    help
        In general, port 8883 is for secured MQTT connections.
        Port 443 requires use of the ALPN TLS extension with the ALPN protocol name.
        When using port 8883, ALPN is not required.

config IOTHUB_ROOTCA_PEM
    string "Exact file name of the Root CA for IoT Hub placed in the certs folder"
    default "az_root_ca.pem"
    help
        Enter the name of the Root CA pem file for Azure IoT Hub.
        This file should be placed in the certs folder of the project.
        The name entered should be exactly the same as name of file in the certs folder.

config IOTHUB_DEVICE_SYMMETRIC_KEY
    string "The Device Symmetric Key from Azure IoT Hub for authentication"
    default ""
    help 
        Enter the symmetric key from the targeted IoT Hub subscription: 

config MQTT_OPTION_SNI
    int "An option to disable Server Name Indication"
    range 0 1
    default 0
    help
        When using a local Mosquitto server setup, SNI needs to be disabled
        for an MQTT broker that only has an IP address but no hostname. However,
        SNI should be enabled whenever possible.

config MQTT_EXAMPLE_STACKSIZE
    int "Set the stack size of the esp32 task for telemetry"
    range 5120 8192
    default 5120
    help
        The actual stack is created by an operating system thread.

config MQTT_NETWORK_BUFFER_SIZE
    int "Size of the network buffer for MQTT packets"
    range 1024 2048
    default 1024
    help
        Size of the network buffer for MQTT packets.

endmenu

menu "Azure FreeRTOS/CoreMQTT Middleware Config"
    
    config MQTT_STATE_ARRAY_MAX_COUNT
        int "Determines the maximum number of MQTT PUBLISH messages, pending acknowledgement at a time"
        range 1 16
        default 10
        help
            Determines the maximum number of MQTT PUBLISH messages, pending
            acknowledgement at a time, that are supported for incoming and outgoing
            direction of messages, separately.
    
    config MQTT_MAX_CONNACK_RECEIVE_RETRY_COUNT
        int "Retry count for reading CONNACK from network"
        range 1 16
        default 2
        help
            It will be used only when the timeoutMs parameter of MQTT_Connect() is passed as 0 . 
            The transport receive for CONNACK will be retried MQTT_MAX_CONNACK_RECEIVE_RETRY_COUNT
            times before timing out. A value of 0 for this config will cause the transport receive 
            for CONNACK to be invoked only once.
    
    config MQTT_PINGRESP_TIMEOUT_MS
        int "Number of milliseconds to wait for a ping response to a ping request as part of the keep-alive mechanism."
        default 500
        help
            If a ping response is not received before this timeout, then MQTT_ProcessLoop will 
            return MQTTKeepAliveTimeout.

endmenu
```

## demo/projects/esp32/azure-esp-freertos/main/Kconfig.projbuild
```kconfig
menu "ESP32 App Config"

config WIFI_SSID
    string "WiFi SSID"
	default "myssid"
	help
		SSID (network name) for the example to connect to.

config WIFI_PASSWORD
    string "WiFi Password"
	default "mypassword"
	help
		WiFi password (WPA or WPA2) for the example to use.

		Can be left blank if the network has no security set.

config WIFI_MAXIMUM_RETRY
	int "Maximum Wifi Connection Retry"
	default 5
	help
		Set the Maximum Retry to connect to desire WIFI Access Point

config MQTT_CLIENT_IDENTIFIER
    string "The MQTT client identifier used in this example"
	default "testClient"
	help
        The MQTT client identifier used in this example. Each client identifier must be unique.
        so edit as required to ensure that no two clients connecting to the same broker use the same client identifier.

config MQTT_BROKER_ENDPOINT
    string "Endpoint of the MQTT broker to connect to"
    default "mqtt.eclipse.org"
    help
        This example can be run with any MQTT broker, that supports server authentication.

config MQTT_BROKER_PORT
    int "Port of the MQTT broker use"
    default 8883
    help
        In general, port 8883 is for secured MQTT connections.
        Port 443 requires use of the ALPN TLS extension with the ALPN protocol name.
        When using port 8883, ALPN is not required.

config MQTT_OPTION_SNI
    int "An option to disable Server Name Indication"
    range 0 1
    default 0
    help
        When using a local Mosquitto server setup, SNI needs to be disabled
        for an MQTT broker that only has an IP address but no hostname. However,
        SNI should be enabled whenever possible.

config MQTT_EXAMPLE_STACKSIZE
    int "Set the stack size of the example task"
    range 5120 8192
    default 5120
    help
        The actual stack is created by an operating system thread.

config MQTT_NETWORK_BUFFER_SIZE
    int "Size of the network buffer for MQTT packets"
    range 1024 2048
    default 1024
    help
        Size of the network buffer for MQTT packets.

endmenu

menu "FreeRTOS coreMQTT"
    
    config MQTT_STATE_ARRAY_MAX_COUNT
        int "Determines the maximum number of MQTT PUBLISH messages, pending acknowledgement at a time"
        range 1 16
        default 10
        help
            Determines the maximum number of MQTT PUBLISH messages, pending
            acknowledgement at a time, that are supported for incoming and outgoing
            direction of messages, separately.
    
    config MQTT_MAX_CONNACK_RECEIVE_RETRY_COUNT
        int "Retry count for reading CONNACK from network"
        range 1 16
        default 2
        help
            It will be used only when the timeoutMs parameter of MQTT_Connect() is passed as 0 . 
            The transport receive for CONNACK will be retried MQTT_MAX_CONNACK_RECEIVE_RETRY_COUNT
            times before timing out. A value of 0 for this config will cause the transport receive 
            for CONNACK to be invoked only once.
    
    config MQTT_PINGRESP_TIMEOUT_MS
        int "Number of milliseconds to wait for a ping response to a ping request as part of the keep-alive mechanism."
        default 500
        help
            If a ping response is not received before this timeout, then MQTT_ProcessLoop will 
            return MQTTKeepAliveTimeout.

endmenu
```

## demo/projects/esp32/esp-freertos/main/Kconfig.projbuild
```kconfig
menu "ESP32 App-Board Configuration"

config WIFI_SSID
    string "WiFi SSID"
	default "myssid"
	help
		SSID (network name) for the example to connect to.

config WIFI_PASSWORD
    string "WiFi Password"
	default "mypassword"
	help
		WiFi password (WPA or WPA2) for the example to use.

		Can be left blank if the network has no security set.

config WIFI_MAXIMUM_RETRY
	int "Maximum Wifi Connection Retry"
	default 5
	help
		Set the Maximum Retry to connect to desire WIFI Access Point


menu "ESP32 App-Azure IoT Configuration"

    config AZ_MQTT_BROKER_PORT
        int "MQTT Broker Port"
        default 8883
        help
            Add the Port for your MQTT Broker connection to Azure IoT

    config AZ_MQTT_BROKER_HOSTNAME
        string "Azure IoT Hub Broker Hostname or URL"
        default "mqtts://mqtt.eclipse.org"
        help
            Your Azure IoT Hub host name or URL of mqtt broker to connects to.

    config AZ_BROKER_CERT
        string "Azure IoT Hub or Broker certificate name"
        default "az_root_ca.pem"
        help
            Please add server certificate name here from server cert file located in certs folder

    config AZ_DEVICE_ID                 
        string "Enter Your Device ID"
        default ""
        help
            Please enter your device Id to be used with Azure IoTHub.

    config AZ_MODULE_ID                 
        string "Enter Your Azure IoT Module ID"
        default ""
        help
            Please enter your module Id to be used with Azure IoTHub.
 
    config AZ_DEVICE_SYMMETRIC_KEY                 
        string "Enter Your Azure IoT Symmetric key"
        help
            Please enter your Device Symmetric key to be used with Azure IoTHub.

    
    
# Add in other Authentication Options later to be used in CMake for DPS etc #
# if RT_USING_USER_MAIN
#    config RT_MAIN_THREAD_STACK_SIZE
#        int "Set main thread stack size"
#       default 2048
#   config RT_MAIN_THREAD_PRIORITY
#       int "Set main thread priority" 
#       default 4  if RT_THREAD_PRIORITY_8
# endif

endmenu
```
